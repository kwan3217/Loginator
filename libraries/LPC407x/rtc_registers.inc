#define RTC_BASE_ADDR 0xE0024000

rw0(rtc,ILR     ,RTC_BASE_ADDR+0x00);
ro0(rtc,CTC     ,RTC_BASE_ADDR+0x04);
rw0(rtc,CCR     ,RTC_BASE_ADDR+0x08);
rw0(rtc,CIIR    ,RTC_BASE_ADDR+0x0C);
rw0(rtc,AMR     ,RTC_BASE_ADDR+0x10);
ro0(rtc,CTIME0  ,RTC_BASE_ADDR+0x14);
ro0(rtc,CTIME1  ,RTC_BASE_ADDR+0x18);
ro0(rtc,CTIME2  ,RTC_BASE_ADDR+0x1C);
rw0(rtc,RTCSEC  ,RTC_BASE_ADDR+0x20);
rw0(rtc,RTCMIN  ,RTC_BASE_ADDR+0x24);
rw0(rtc,RTCHOUR ,RTC_BASE_ADDR+0x28);
rw0(rtc,RTCDOM  ,RTC_BASE_ADDR+0x2C);
rw0(rtc,RTCDOW  ,RTC_BASE_ADDR+0x30);
rw0(rtc,RTCDOY  ,RTC_BASE_ADDR+0x34);
rw0(rtc,RTCMONTH,RTC_BASE_ADDR+0x38);
rw0(rtc,RTCYEAR ,RTC_BASE_ADDR+0x3C);
rw0(rtc,ALSEC   ,RTC_BASE_ADDR+0x60);
rw0(rtc,ALMIN   ,RTC_BASE_ADDR+0x64);
rw0(rtc,ALHOUR  ,RTC_BASE_ADDR+0x68);
rw0(rtc,ALDOM   ,RTC_BASE_ADDR+0x6C);
rw0(rtc,ALDOW   ,RTC_BASE_ADDR+0x70);
rw0(rtc,ALDOY   ,RTC_BASE_ADDR+0x74);
rw0(rtc,ALMON   ,RTC_BASE_ADDR+0x78);
rw0(rtc,ALYEAR  ,RTC_BASE_ADDR+0x7C);
rw0(rtc,PREINT  ,RTC_BASE_ADDR+0x80);
rw0(rtc,PREFRAC ,RTC_BASE_ADDR+0x84);

#undef RTC_BASE_ADDR